## mymodule/Kconfig
```kconfig
menuconfig EXAMPLES_MYMODULE
	bool "mymodule"
	default n
	---help---
		Enable support for mymodule
```

## mymodule_subscribe/Kconfig
```kconfig
menuconfig EXAMPLES_MYMODULE_SUBSCRIBE
	bool "mymodule_subscribe"
	default n
	---help---
		Enable support for mymodule_subscribe
```

## mypublish/Kconfig
```kconfig
menuconfig EXAMPLES_MYPUBLISH
	bool "mypublish"
	default n
	---help---
		Enable support for mypublish
```

## mysubscribe/Kconfig
```kconfig
menuconfig EXAMPLES_MYSUBSCRIBE
	bool "mysubscribe"
	default n
	---help---
		Enable support for mysubscribe
```

## simple_c_app/Kconfig
```kconfig
menuconfig EXAMPLES_SIMPLE_C_APP
	bool "simple_c_app"
	default n
	---help---
		Enable support for simple_c_app
```

## simple_cpp_app/Kconfig
```kconfig
menuconfig EXAMPLES_SIMPLE_CPP_APP
	bool "simple_cpp_app"
	default n
	---help---
		Enable support for simple_cpp_app
```

## simple_subscribe/Kconfig
```kconfig
menuconfig EXAMPLES_SIMPLE_SUBSCRIBE
	bool "simple_subscribe"
	default n
	---help---
		Enable support for simple_subscribe
```
